/ {
	reg_vcc3v3: vcc3v3 {
		compatible = "regulator-fixed";
		regulator-name = "vcc3v3";
		regulator-min-microvolt = <3300000>;
		regulator-max-microvolt = <3300000>;
	};
};

&mmc0 {
	vmmc-supply = <&reg_vcc3v3>;
};

&mmc2 {
	vmmc-supply = <&reg_vcc3v3>;
};
