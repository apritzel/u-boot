## arch/arm/mach-nexell/Kconfig
```kconfig
if ARCH_NEXELL

config SYS_SOC
    default "nexell"

config SYS_CONFIG_NAME
    default "s5p6818"

endif
```

## configs/avaota-a1_defconfig
```kconfig
CONFIG_ARM=y
CONFIG_ARCH_SUNXI=y
CONFIG_DEFAULT_DEVICE_TREE="sun55i-t527-avaota-a1"
CONFIG_MACH_SUN55I_A523=y
CONFIG_DRAM_CLK=1200
CONFIG_DRAM_ZQ=0		/* placeholder for now */
CONFIG_USB1_VBUS_PIN="PI12"
# CONFIG_SYS_MALLOC_CLEAR_ON_INIT is not set
CONFIG_SYS_I2C_MVTWSI=y
CONFIG_PHY_REALTEK=y
CONFIG_SUN8I_EMAC=y
CONFIG_USB_EHCI_HCD=y
CONFIG_USB_OHCI_HCD=y
CONFIG_USB_MUSB_GADGET=y
CONFIG_USB_HOST_ETHER=y
CONFIG_USB_ETHER_RTL8152=y
```

## configs/nanopi_m3_defconfig
```kconfig
CONFIG_ARM=y
CONFIG_ARCH_NEXELL=y
# CONFIG_DISPLAY_CPUINFO is not set
# CONFIG_CMD_FLASH is not set
# CONFIG_SYS_ARCH_TIMER is not set
CONFIG_DEFAULT_DEVICE_TREE="s5p6818-nanopi-m3"
CONFIG_HUSH_PARSER=y
CONFIG_CMD_MMC=y
CONFIG_CMD_EXT4=y
CONFIG_CMD_EXT4_WRITE=y
CONFIG_CMD_FAT=y
CONFIG_CMD_FS_GENERIC=y
```

## configs/orangepi_zero2_defconfig
```kconfig
CONFIG_ARM=y
CONFIG_ARCH_SUNXI=y
CONFIG_SPL=y
CONFIG_MACH_SUN50I_H616=y
CONFIG_DRAM_CLK=696
CONFIG_MMC0_CD_PIN="PF6"
# CONFIG_PSCI_RESET is not set
CONFIG_DEFAULT_DEVICE_TREE="sun50i-h616-orangepi-zero2"
# CONFIG_SYS_MALLOC_CLEAR_ON_INIT is not set
CONFIG_PHY_REALTEK=y
CONFIG_SUN8I_EMAC=y
CONFIG_SPL_I2C_SUPPORT=y
```

## configs/sun50i-a64-ddr3_defconfig
```kconfig
CONFIG_ARM=y
CONFIG_ARCH_SUNXI=y
CONFIG_MACH_SUN50I=y
CONFIG_DEFAULT_DEVICE_TREE="sun50i-a64-pine64-plus"
# CONFIG_SYS_MALLOC_CLEAR_ON_INIT is not set
CONFIG_SPL=y
# CONFIG_CMD_FLASH is not set
# CONFIG_SPL_DOS_PARTITION is not set
# CONFIG_SPL_ISO_PARTITION is not set
# CONFIG_SPL_EFI_PARTITION is not set
CONFIG_OF_LIST="sun50i-a64-pine64 sun50i-a64-pine64-plus sun50i-a64-bananapi-m64 sun50i-a64-orangepi-win sun50i-a64-nanopi-a64 sun50i-a64-olinuxino"
CONFIG_SUN8I_EMAC=y
CONFIG_USB_EHCI_HCD=y
CONFIG_SYS_USB_EVENT_POLL_VIA_INT_QUEUE=y
CONFIG_SPL_SPI_SUNXI=y
CONFIG_MMC_SUNXI_SLOT_EXTRA=2
# CONFIG_SYS_WHITE_ON_BLACK is not set
CONFIG_VIDEO_FONT_SUN12X22=y
```

## configs/sun50i-a64-lpddr3-spl_defconfig
```kconfig
CONFIG_ARM=y
CONFIG_ARCH_SUNXI=y
CONFIG_SPL=y
CONFIG_MACH_SUN50I=y
CONFIG_SUNXI_ARMV8_32BIT_BUILD=y
CONFIG_SUNXI_DRAM_LPDDR3_STOCK=y
CONFIG_DRAM_CLK=552
CONFIG_DRAM_ZQ=3881949
CONFIG_NR_DRAM_BANKS=1
# CONFIG_SYS_MALLOC_CLEAR_ON_INIT is not set
# CONFIG_CMD_FLASH is not set
# CONFIG_SPL_DOS_PARTITION is not set
# CONFIG_SPL_EFI_PARTITION is not set
CONFIG_DEFAULT_DEVICE_TREE="sun50i-a64-pine64-lts"
CONFIG_MMC0_CD_PIN=""
CONFIG_SPL_SPI_SUNXI=y
CONFIG_MMC_SUNXI_SLOT_EXTRA=2
```

## configs/sun50i-h5-ddr3-spl_defconfig
```kconfig
CONFIG_ARM=y
CONFIG_ARCH_SUNXI=y
CONFIG_SPL=y
CONFIG_MACH_SUN50I_H5=y
CONFIG_SUNXI_ARMV8_32BIT_BUILD=y
CONFIG_DRAM_CLK=672
CONFIG_DRAM_ZQ=3881977
CONFIG_SPL_SPI_SUNXI=y
CONFIG_NR_DRAM_BANKS=1
# CONFIG_SYS_MALLOC_CLEAR_ON_INIT is not set
# CONFIG_CMD_FLASH is not set
# CONFIG_SPL_DOS_PARTITION is not set
# CONFIG_SPL_EFI_PARTITION is not set
CONFIG_DEFAULT_DEVICE_TREE="sun50i-h5-orangepi-pc2"
CONFIG_MMC_SUNXI_SLOT_EXTRA=2
CONFIG_SYS_USB_EVENT_POLL_VIA_INT_QUEUE=y
```

## configs/sun50i-h6-lpddr3-spl_defconfig
```kconfig
CONFIG_ARM=y
CONFIG_ARCH_SUNXI=y
CONFIG_SPL=y
CONFIG_MACH_SUN50I_H6=y
CONFIG_SUNXI_ARMV8_32BIT_BUILD=y
CONFIG_MMC_SUNXI_SLOT_EXTRA=2
CONFIG_NR_DRAM_BANKS=1
# CONFIG_SYS_MALLOC_CLEAR_ON_INIT is not set
# CONFIG_CMD_FLASH is not set
# CONFIG_SPL_DOS_PARTITION is not set
# CONFIG_SPL_EFI_PARTITION is not set
CONFIG_DEFAULT_DEVICE_TREE="sun50i-h6-pine-h64"
```

## configs/sun50i_defconfig
```kconfig
CONFIG_ARM=y
CONFIG_ARCH_SUNXI=y
CONFIG_SPL=y
CONFIG_MACH_SUN50I=y
CONFIG_SUNXI_MULTI_SOC=y
# CONFIG_MACH_SUN50I_H5=y	# this clashes with the above in the moment
# CONFIG_ARMV8_SPL_EXCEPTION_VECTORS is not set
CONFIG_SUNXI_DRAM_DDR3=y
CONFIG_SUNXI_DRAM_DDR3_1333=y
CONFIG_SUNXI_DRAM_LPDDR3=y
CONFIG_SUNXI_DRAM_LPDDR3_STOCK=y
CONFIG_MMC0_CD_PIN=""
CONFIG_DEFAULT_DEVICE_TREE="sun50i-a64-pine64-plus"
CONFIG_OF_LIST="sunxi-1689-generic sunxi-1718-generic sun50i-a64-amarula-relic sun50i-a64-bananapi-m64 sun50i-a64-nanopi-a64 sun50i-a64-olinuxino sun50i-a64-orangepi-win sun50i-a64-pine64-lts sun50i-a64-pine64-plus sun50i-a64-pine64 sun50i-a64-sopine-baseboard sun50i-h5-libretech-all-h3-cc sun50i-h5-nanopi-neo-plus2 sun50i-h5-nanopi-neo2 sun50i-h5-orangepi-pc2 sun50i-h5-orangepi-prime sun50i-h5-orangepi-zero-plus sun50i-h5-orangepi-zero-plus2"
CONFIG_MMC_SUNXI_SLOT_EXTRA=2
```

## configs/sun50i_spl_defconfig
```kconfig
CONFIG_ARM=y
CONFIG_ARCH_SUNXI=y
CONFIG_SPL=y
CONFIG_MACH_SUN50I=y
CONFIG_SUNXI_ARMV8_32BIT_BUILD=y
CONFIG_SUNXI_MULTI_SOC=y
# CONFIG_MACH_SUN50I_H5=y	# this clashes with the above in the moment
CONFIG_SUNXI_DRAM_DDR3=y
CONFIG_SUNXI_DRAM_DDR3_1333=y
CONFIG_SUNXI_DRAM_LPDDR3=y
CONFIG_SUNXI_DRAM_LPDDR3_STOCK=y
CONFIG_MMC0_CD_PIN=""
CONFIG_DEFAULT_DEVICE_TREE="sun50i-a64-pine64-lts"
CONFIG_MMC_SUNXI_SLOT_EXTRA=2
CONFIG_SPL_SPI_SUNXI=y
CONFIG_SYS_SPI_U_BOOT_OFFS=0x8000
```

## configs/tanix_tx6s_defconfig
```kconfig
CONFIG_ARM=y
CONFIG_ARCH_SUNXI=y
CONFIG_SPL=y
CONFIG_MACH_SUN50I_H616=y
CONFIG_DRAM_CLK=696
CONFIG_MMC0_CD_PIN="PF6"
# CONFIG_PSCI_RESET is not set
CONFIG_DEFAULT_DEVICE_TREE="sun50i-h6-orangepi-lite2"
# CONFIG_SYS_MALLOC_CLEAR_ON_INIT is not set
CONFIG_SPL_I2C_SUPPORT=y
```

## configs/teclast_p80_defconfig
```kconfig
CONFIG_ARM=y
CONFIG_ARCH_SUNXI=y
CONFIG_DEFAULT_DEVICE_TREE="allwinner/sun50i-a133-teclast-p80"
CONFIG_SPL=y
CONFIG_DRAM_SUN50I_DX_ODT=0x3030303
CONFIG_DRAM_SUN50I_DX_DRI=0xc0c0c0c
CONFIG_DRAM_SUN50I_CA_DRI=0x1919
CONFIG_DRAM_SUN50I_TPR10=0x2f7777
CONFIG_MACH_SUN50I_A133=y
CONFIG_SUNXI_DRAM_A133_DDR4=y
CONFIG_R_I2C_ENABLE=y
CONFIG_SPL_SPI_SUNXI=y
CONFIG_SPL_IMAGE_TYPE_SUNXI_TOC0=y
# CONFIG_SYS_MALLOC_CLEAR_ON_INIT is not set
CONFIG_SPL_I2C=y
CONFIG_SPL_SYS_I2C_LEGACY=y
CONFIG_SYS_I2C_MVTWSI=y
CONFIG_SYS_I2C_SLAVE=0x7f
CONFIG_SYS_I2C_SPEED=400000
CONFIG_AXP803_POWER=y
CONFIG_AXP_DCDC5_VOLT=1100
```

## configs/teclast_p8_defconfig
```kconfig
CONFIG_ARM=y
CONFIG_ARCH_SUNXI=y
CONFIG_DEFAULT_DEVICE_TREE="sun50i-a133-teclast-p8"
CONFIG_SPL=y
CONFIG_DRAM_SUN50I_H616_DX_ODT=0x08080808
CONFIG_DRAM_SUN50I_H616_DX_DRI=0x0e0e0e0e
CONFIG_DRAM_SUN50I_H616_CA_DRI=0x0e0e
CONFIG_DRAM_SUN50I_H616_TPR10=0xf83438
CONFIG_SUNXI_DRAM_H616_DDR3_1333=y
CONFIG_MACH_SUN50I_A133=y
CONFIG_MMC0_CD_PIN="PF6"
# CONFIG_SYS_MALLOC_CLEAR_ON_INIT is not set
CONFIG_SYS_MONITOR_LEN=786432
```

## configs/x96q_pro_plus_defconfig
```kconfig
CONFIG_ARM=y
CONFIG_ARCH_SUNXI=y
CONFIG_DEFAULT_DEVICE_TREE="sun55i-h728-x96qpro+"
CONFIG_MACH_SUN55I_A523=y
CONFIG_DRAM_CLK=792
CONFIG_DRAM_ZQ=0		/* placeholder for now */
CONFIG_USB1_VBUS_PIN="PI12"
# CONFIG_SYS_MALLOC_CLEAR_ON_INIT is not set
CONFIG_SYS_I2C_MVTWSI=y
CONFIG_USB_EHCI_HCD=y
CONFIG_USB_OHCI_HCD=y
CONFIG_USB_HOST_ETHER=y
CONFIG_USB_ETHER_RTL8152=y
```

## drivers/ram/sunxi/Kconfig
```kconfig
config DRAM_SUN20I_D1
	bool "DM DRAM driver support for Allwinner D1"
	depends on RAM && ARCH_SUNXI
	default y
	help
	  This enables support for DRAM drivers using the driver model
	  for Allwinner SoCs.

config DRAM_SUN8I_R528
	bool "DRAM driver support for Allwinner R528/T113s"
	default y if MACH_SUN8I_R528
	help
	  Select this DRAM controller driver for the R528/T113s SoCs.
```
